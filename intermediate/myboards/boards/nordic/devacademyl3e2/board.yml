## intermediate/myboards/boards/nordic/devacademyl3e2/board.yml
```yaml
board:
  name: devacademyl3e2
  full_name: DevAcademyL3E2
  vendor: nordic
  socs:
    - name: nrf9151
      variants:
        - name: "ns"
```
